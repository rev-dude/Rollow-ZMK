/*
 * Copyright (c) 2021 The ZMK Contributors
 *
 * SPDX-License-Identifier: MIT
 */

/dts-v1/;
#include "nice_nano.dtsi"

/ {
	chosen {
		zmk,battery = &vbatt;
		zmk,default-power-domain = &ext_power_domain;
	};

	ext_power_domain: ext-power {
		compatible = "power-domain-gpio";
		label = "EXT_POWER";
		enable-gpios = <&gpio0 13 GPIO_ACTIVE_HIGH>;
		startup-delay-us = <50000>;
	};

	vbatt: vbatt {
		compatible = "zmk,battery-nrf-vddh";
		label = "BATTERY";
	};
};
